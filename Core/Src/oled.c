#include "oled.h"
#include <string.h>

/* 告诉编译器：hi2c1 在别的文件里定义了，你去找找 */
extern I2C_HandleTypeDef hi2c1;

// SSD1306 的 I2C 地址
#define OLED_ADDR 0x78

// 标准ASCII 6x8 点阵字库 (空格 ~ '~')
static const uint8_t Font6x8[][6] = {
    {0x00, 0x00, 0x00, 0x00, 0x00, 0x00}, // sp
    {0x00, 0x00, 0x00, 0x2f, 0x00, 0x00}, // !
    {0x00, 0x00, 0x07, 0x00, 0x07, 0x00}, // "
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    {0x00, 0x00, 0x06, 0x09, 0x09, 0x06}  // ~ (实际上显示的是类似~的符号，根据需要调整)
};

// 发送一个字节的命令
void OLED_WriteCmd(uint8_t cmd)
{
    uint8_t data[2] = {0x00, cmd};
    HAL_I2C_Master_Transmit(&hi2c1, OLED_ADDR, data, 2, 10);
}

// 发送一个字节的数据
void OLED_WriteData(uint8_t dat)
{
    uint8_t data[2] = {0x40, dat};
    HAL_I2C_Master_Transmit(&hi2c1, OLED_ADDR, data, 2, 10);
}

// 初始化 OLED
void OLED_Init(void)
{
    HAL_Delay(100);      // 等屏幕稳定
    OLED_WriteCmd(0xAE); // 关闭显示
    OLED_WriteCmd(0x20); // 设置内存地址模式
    OLED_WriteCmd(0x00); // 水平寻址模式
    OLED_WriteCmd(0xB0); // 设置页(0~7)
    OLED_WriteCmd(0xC8); // 从上到下扫描 COM
    OLED_WriteCmd(0x00); // 低列开始地址
    OLED_WriteCmd(0x10); // 高列开始地址
    OLED_WriteCmd(0x40); // 显示起始行
    OLED_WriteCmd(0x81); // 设置对比度
    OLED_WriteCmd(0xFF);
    OLED_WriteCmd(0xA1); // 设置段重映射 (左右镜像)
    OLED_WriteCmd(0xA6); // 正常显示(非反白)
    OLED_WriteCmd(0xA8); // 设置多路复用比
    OLED_WriteCmd(0x3F);
    OLED_WriteCmd(0xA4); // 输出遵循 RAM 内容
    OLED_WriteCmd(0xD3); // 设置显示偏移
    OLED_WriteCmd(0x00);
    OLED_WriteCmd(0xD5); // 设置显示时钟分频
    OLED_WriteCmd(0xF0);
    OLED_WriteCmd(0xD9); // 设置预充电周期
    OLED_WriteCmd(0x22);
    OLED_WriteCmd(0xDA); // 设置 COM 引脚硬件配置
    OLED_WriteCmd(0x02);
    OLED_WriteCmd(0xDB); // 设置 VCOMH 取消选择级别
    OLED_WriteCmd(0x20);
    OLED_WriteCmd(0x8D); // 启用电荷泵调节器
    OLED_WriteCmd(0x14);
    OLED_WriteCmd(0xAF); // 开启显示
    // --- 强制全屏清屏 (地址修正版) ---
    OLED_WriteCmd(0x20); // 设置内存寻址模式
    OLED_WriteCmd(0x00); // 水平寻址模式

    for (uint8_t i = 0; i < 8; i++)
    {                            // 遍历8页
        OLED_WriteCmd(0xB0 + i); // 设置页地址
        OLED_WriteCmd(0x00);     // 设置列低地址
        OLED_WriteCmd(0x10);     // 设置列高地址

        for (uint8_t j = 0; j < 128; j++)
        {                         // 遍历128列
            OLED_WriteData(0x00); // 写入全黑数据
        }
    }
    // --- 清屏结束 ---
}

// 显示一个英文字符串，每行 21 个字，共 4 行。x=0-20(字符列), y=0-3(行)
void OLED_ShowString(uint8_t x, uint8_t y, const char *str)
{
    uint8_t c;
    x = x * 6; // 将字符列位置转换为像素位置 (每个字符占6像素)
    while (*str)
    {
        c = *str - 32; // 空格是字库的第0个
        if (c > 94)
            c = 0; // 超出显示范围，显示空格

        OLED_WriteCmd(0xB0 + y);                 // 设置页
        OLED_WriteCmd((x & 0x0F) | 0x00);        // 设置低列 (先发低4位)
        OLED_WriteCmd(((x & 0xF0) >> 4) | 0x10); // 设置高列 (后发高4位)

        for (uint8_t i = 0; i < 6; i++)
        {
            OLED_WriteData(Font6x8[c][i]);
        }

        x += 6; // 每个字符宽度6像素
        if (x > 122)
        {
            x = 0;
            y++;
        } // 自动换行
        str++;
    }
}
